## conf/machine/onekiwi.conf
```bitbake
#@TYPE: Machine
#@NAME: onekiwi
#@DESCRIPTION: Configuration for all STM32MP1 boards (EV, DK, ...)
#@NEEDED_BSPLAYERS: layers/meta-openembedded/meta-oe layers/meta-openembedded/meta-python

include conf/machine/include/st-machine-common-stm32mp.inc
include conf/machine/include/st-machine-providers-stm32mp.inc

# Define specific familly common machine name
MACHINEOVERRIDES .= ":stm32mp1common"
MACHINEOVERRIDES .= ":stm32mp15common"

# =========================================================================
# Chip architecture
# =========================================================================
DEFAULTTUNE = "cortexa7thf-neon-vfpv4"
include conf/machine/include/tune-cortexa7.inc

# =========================================================================
# boot scheme
# =========================================================================
BOOTSCHEME_LABELS += "trusted"
#BOOTSCHEME_LABELS += "optee"

# =========================================================================
# boot device
# =========================================================================
# Define the boot device supported
BOOTDEVICE_LABELS += "emmc"
BOOTDEVICE_LABELS += "sdcard"
#BOOTDEVICE_LABELS += "nand-4-256"
#BOOTDEVICE_LABELS += "nor-sdcard"

# =========================================================================
# Machine settings
# =========================================================================
# Define list of devicetree per board

#STM32MP_DT_FILES_EV += "stm32mp157caa-thatico-r2x512v10"
STM32MP_DT_FILES_EV += "stm32mp157caa-thatico-r2x512v12"
STM32MP_DT_FILES_EV += "stm32mp151aaa-thatico-r2x512v11"
STM32MP_DT_FILES_EV += "stm32mp151aaa-thatico-r2x512v12"
STM32MP_DT_FILES_EV += "stm32mp157aaa-thatico-r2x512v12"
STM32MP_DT_FILES_EV += "stm32mp15xxab-som-v11"
#STM32MP_DT_FILES_EV += "stm32mp151a-kiwi"

# =========================================================================
# Machine features
# =========================================================================
MACHINE_FEATURES += "splashscreen"
MACHINE_FEATURES += "watchdog"
MACHINE_FEATURES += "bluetooth"
MACHINE_FEATURES += "wifi"
MACHINE_FEATURES += "dsi"
MACHINE_FEATURES += "${@'gpu' if d.getVar('ACCEPT_EULA_'+d.getVar('MACHINE')) == '1' else ''}"
MACHINE_FEATURES += "m4copro"

# Bluetooth
BLUETOOTH_LIST += "linux-firmware-bluetooth-bcm4343"
# Wifi
WIFI_LIST += "linux-firmware-bcm43430"

# =========================================================================
# Kernel
# =========================================================================
# For eval board: auto-load goodix module (touchscreen module)
KERNEL_MODULE_AUTOLOAD = "goodix"

# Define the devicetree for Linux A7 examples
LINUX_A7_EXAMPLES_DT += "stm32mp151a-kiwi-a7-examples"

# =========================================================================
# M4 copro
# =========================================================================
# Define the devicetree for M4 example
CUBE_M4_EXAMPLES_DT += "stm32mp151a-kiwi-m4-examples"
```
